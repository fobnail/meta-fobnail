## meta-fobnail-bsp/conf/layer.conf
```bitbake
# We have a conf and classes directory, add to BBPATH
BBPATH .= ":${LAYERDIR}"

# We have recipes-* directories, add to BBFILES
BBFILES += "${LAYERDIR}/recipes-*/*/*.bb ${LAYERDIR}/recipes-*/*/*.bbappend"

BBFILE_COLLECTIONS += "fobnail-bsp"
BBFILE_PATTERN_fobnail-bsp = "^${LAYERDIR}/"
BBFILE_PRIORITY_fobnail-bsp = "1"

# This should only be incremented on significant changes that will
# cause compatibility issues with other layers
LAYERVERSION_fobnail-bsp = "1"

LAYERDEPENDS_fobnail-bsp = " \
    core \
    openembedded-layer \
    "

LAYERSERIES_COMPAT_fobnail-bsp = "honister master"
```

## meta-fobnail-bsp/conf/machine/fobnail-machine.conf
```bitbake
require conf/machine/pcengines-apu2.conf

PREFERRED_PROVIDER_virtual/kernel = "linux-tb"

IMAGE_BOOT_FILES = "bzImage"

MACHINE_EXTRA_RRECOMMENDS:remove = " grub"
MACHINE_EXTRA_RRECOMMENDS:append = " grub-tb-common"
```

## meta-fobnail-distro/conf/distro/fobnail-distro.conf
```bitbake
require conf/distro/poky.conf

DISTRO = "fobnail-distro"

# distro name
DISTRO_NAME = "Distro for fobnail product"
DISTRO_VERSION = "0.1.3"
SDK_VENDOR = "-fobnailsdk"

MAINTAINER = "3mdeb Embedded Systems Consulting <contact@3mdeb.com>"

TARGET_VENDOR = "-fobnail"

# distro features
# DISTRO_FEATURES_DEFAULT ?= "acl alsa argp bluetooth ext2 ipv4 ipv6 largefile pcmcia usbgadget usbhost wifi xattr nfs zeroconf pci 3g nfc x11 vfat"
# POKY_DEFAULT_DISTRO_FEATURES = "largefile opengl ptest multiarch wayland vulkan"
DISTRO_FEATURES = "${DISTRO_FEATURES_DEFAULT} systemd tpm"

# explictely use systemd and disable sysvinit completely
VIRTUAL-RUNTIME_init_manager = "systemd"
VIRTUAL-RUNTIME_initscripts = ""
VIRTUAL-RUNTIME_syslog = ""
DISTRO_FEATURES_BACKFILL_CONSIDERED += "sysvinit pulseaudio"

ROOT_PASSWORD = "ZRVoD3Z"
# According to https://docs.yoctoproject.org/singleindex.html#extrausers-bbclass
# mkpasswd should be used in order to set account password, this password for
# root was created with the meta-fobnail layer using the following command:
# `printf "%q" $(mkpasswd -m sha256crypt $ROOT_PASSWORD)`
ROOT_PASSWD = "\$5\$N9ygbAN1ud\$AmRVopSd/ziTGXDv7UXNTb2mPl/.OJ0DAeLaMMlqww/"


WKS_FILE = "sdimage-fobnail.wks"
IMAGE_FSTYPES = "wic.gz wic.bmap"
```

## meta-fobnail-distro/conf/layer.conf
```bitbake
# We have a conf and classes directory, add to BBPATH
BBPATH .= ":${LAYERDIR}"

# We have recipes-* directories, add to BBFILES
BBFILES += "${LAYERDIR}/recipes-*/*/*.bb ${LAYERDIR}/recipes-*/*/*.bbappend"

BBFILE_COLLECTIONS += "fobnail-distro"
BBFILE_PATTERN_fobnail-distro = "^${LAYERDIR}/"
BBFILE_PRIORITY_fobnail-distro = "1"

# This should only be incremented on significant changes that will
# cause compatibility issues with other layers
LAYERVERSION_fobnail-distro = "1"

LAYERDEPENDS_fobnail-distro = " \
    core \
    openembedded-layer \
    "

LAYERSERIES_COMPAT_fobnail-distro = "honister master"
```

## meta-fobnail-distro/wic/sdimage-fobnail.wks
```
# short-description: Create system image with fobnail application
# long-description: Creates a partitioned system image for use with
# pcengines-apu2. Boot files are located in the first vfat partition.

part /boot  --source bootimg-partition --ondisk mmcblk0 --fstype=vfat --label boot   --align 4096 --fixed-size 64  --active
part /      --source rootfs            --ondisk mmcblk0 --fstype=ext4 --label rootfs --align 4096 --fixed-size 512
```
